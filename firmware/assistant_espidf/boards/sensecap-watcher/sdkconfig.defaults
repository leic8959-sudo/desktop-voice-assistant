## firmware/assistant_espidf/boards/sensecap-watcher/sdkconfig.defaults
```kconfig
CONFIG_ESPTOOLPY_FLASHSIZE_32MB=y
CONFIG_SPIRAM_MODE_OCT=y
CONFIG_CODEC_ES8311_SUPPORT=y
CONFIG_CODEC_ES7243E_SUPPORT=y
CONFIG_BOOTLOADER_CACHE_32BIT_ADDR_QUAD_FLASH=y
CONFIG_ESPTOOLPY_FLASH_MODE_AUTO_DETECT=n
CONFIG_IDF_EXPERIMENTAL_FEATURES=y
```

## firmware/assistant_espidf/boards/taiji-pi-s3-pdm/sdkconfig.defaults
```kconfig
CONFIG_SPIRAM_MODE_OCT=y
CONFIG_SPIRAM_TRY_ALLOCATE_WIFI_LWIP=y
CONFIG_CODEC_DUMMY_SUPPORT=y
```

## firmware/assistant_espidf/boards/waveshare-amoled-1.75c/sdkconfig.defaults
```kconfig
CONFIG_SPIRAM_MODE_OCT=y
CONFIG_BSP_SPIFFS_FORMAT_ON_MOUNT_FAIL=n
CONFIG_ESPTOOLPY_FLASHSIZE_32MB=y
```

## firmware/assistant_espidf/boards/waveshare-amoled-1.8-sh8601/sdkconfig.defaults
```kconfig
CONFIG_SPIRAM_MODE_OCT=y
CONFIG_BSP_DISPLAY_LVGL_BUF_HEIGHT=10
CONFIG_BSP_SD_FORMAT_ON_MOUNT_FAIL=n
CONFIG_BSP_SPIFFS_FORMAT_ON_MOUNT_FAIL=n
```

## firmware/assistant_espidf/boards/waveshare-amoled-2.06/sdkconfig.defaults
```kconfig
CONFIG_SPIRAM_MODE_OCT=y
CONFIG_ESPTOOLPY_FLASHSIZE_32MB=y
CONFIG_BSP_SPIFFS_FORMAT_ON_MOUNT_FAIL=n
CONFIG_BSP_SD_FORMAT_ON_MOUNT_FAIL=n
CONFIG_BSP_DISPLAY_LVGL_BUF_HEIGHT=20
CONFIG_BSP_DISPLAY_LVGL_AVOID_TEAR=n
```

## firmware/assistant_espidf/boards/waveshare-esp32-c5-touch-lcd-1.69/sdkconfig.defaults
```kconfig
CONFIG_SPIRAM=y
CONFIG_SPIRAM_MODE_QUAD=y
CONFIG_SPIRAM_SPEED_80M=y
CONFIG_SPI_FLASH_FREQ_LIMIT_C5_240MHZ=y
CONFIG_CODEC_ES8311_SUPPORT=y
CONFIG_SR_WN_WN9S_NIHAOXIAOZHI=y
```

## firmware/assistant_espidf/boards/waveshare-esp32-p4-wifi6-touch-lcd-7b/sdkconfig.defaults
```kconfig
CONFIG_ESP_WIFI_REMOTE_ENABLED=y
CONFIG_ESP_WIFI_REMOTE_LIBRARY_HOSTED=y
CONFIG_SLAVE_IDF_TARGET_ESP32C6=y
CONFIG_ESP_HOSTED_ENABLED=y
CONFIG_ESP_HOSTED_CP_TARGET_ESP32C6=y
CONFIG_ESP_HOSTED_P4_DEV_BOARD_NONE=y
CONFIG_ESP_HOSTED_SDIO_HOST_INTERFACE=y
CONFIG_ESP_HOSTED_SDIO_4_BIT_BUS=y
CONFIG_ESP_HOSTED_SDIO_SLOT_1=y
CONFIG_CODEC_ES8311_SUPPORT=y
CONFIG_CODEC_ES7210_SUPPORT=y
CONFIG_LVGL_PORT_ENABLE_PPA=n
CONFIG_SPI_FLASH_SUPPORT_GD_CHIP=y
CONFIG_ESP32P4_SELECTS_REV_LESS_V3=y
CONFIG_ESP32P4_REV_MIN_100=y
CONFIG_ESP_LCD_TOUCH_MAX_POINTS=5
CONFIG_ESPTOOLPY_FLASHSIZE_32MB=y
CONFIG_ESPTOOLPY_FLASH_MODE_AUTO_DETECT=n
CONFIG_PARTITION_TABLE_CUSTOM_FILENAME="partitions.csv"
CONFIG_SPIRAM_MALLOC_ALWAYSINTERNAL=0
```

## firmware/assistant_espidf/boards/waveshare-esp32-p4x-wifi6-touch-lcd-3.5/sdkconfig.defaults
```kconfig
CONFIG_ESP_WIFI_REMOTE_ENABLED=y
CONFIG_ESP_WIFI_REMOTE_LIBRARY_HOSTED=y
CONFIG_SLAVE_IDF_TARGET_ESP32C6=y
CONFIG_ESP_HOSTED_ENABLED=y
CONFIG_ESP_HOSTED_CP_TARGET_ESP32C6=y
CONFIG_ESP_HOSTED_P4_DEV_BOARD_NONE=y
CONFIG_ESP_HOSTED_SDIO_HOST_INTERFACE=y
CONFIG_ESP_HOSTED_SDIO_4_BIT_BUS=y
CONFIG_ESP_HOSTED_SDIO_SLOT_1=y
CONFIG_CODEC_ES8311_SUPPORT=y
CONFIG_SPI_FLASH_SUPPORT_GD_CHIP=y
CONFIG_ESP32P4_SELECTS_REV_LESS_V3=n
CONFIG_ESP32P4_REV_MIN_300=y
```

## firmware/assistant_espidf/boards/waveshare-esp32-p4x-wifi6-touch-lcd-5/sdkconfig.defaults
```kconfig
CONFIG_ESP_WIFI_REMOTE_ENABLED=y
CONFIG_ESP_WIFI_REMOTE_LIBRARY_HOSTED=y
CONFIG_SLAVE_IDF_TARGET_ESP32C6=y
CONFIG_ESP_HOSTED_ENABLED=y
CONFIG_ESP_HOSTED_CP_TARGET_ESP32C6=y
CONFIG_ESP_HOSTED_P4_DEV_BOARD_NONE=y
CONFIG_ESP_HOSTED_SDIO_HOST_INTERFACE=y
CONFIG_ESP_HOSTED_SDIO_4_BIT_BUS=y
CONFIG_ESP_HOSTED_SDIO_SLOT_1=y
CONFIG_CODEC_ES8311_SUPPORT=y
CONFIG_SPI_FLASH_SUPPORT_GD_CHIP=y
CONFIG_CODEC_ES7210_SUPPORT=y
CONFIG_LVGL_PORT_ENABLE_PPA=n
CONFIG_ESP_LCD_TOUCH_MAX_POINTS=5
CONFIG_ESPTOOLPY_FLASHSIZE_16MB=y
CONFIG_SPIRAM_MALLOC_ALWAYSINTERNAL=0
CONFIG_ESP32P4_SELECTS_REV_LESS_V3=n
CONFIG_ESP32P4_REV_MIN_300=y
CONFIG_ESP_LCD_HX8394_SKIP_I2C_INIT=y
```

## firmware/assistant_espidf/boards/waveshare-esp32-s3-epaper-1.54-v2/sdkconfig.defaults
```kconfig
CONFIG_ESPTOOLPY_FLASHSIZE_8MB=y
CONFIG_SPIRAM_MODE_OCT=y
CONFIG_CODEC_ES8311_SUPPORT=y
CONFIG_LV_FONT_SOURCE_HAN_SANS_SC_14_CJK=y
CONFIG_LV_FONT_MONTSERRAT_10=y
```

## firmware/assistant_espidf/boards/waveshare-esp32-s3-epaper-3.97/sdkconfig.defaults
```kconfig
CONFIG_SPIRAM_MODE_OCT=y
CONFIG_CODEC_ES8311_SUPPORT=y
CONFIG_LV_FONT_MONTSERRAT_20=y
```

## firmware/assistant_espidf/boards/waveshare-esp32-s3-rgb-matrix/sdkconfig.defaults
```kconfig
CONFIG_ESPTOOLPY_FLASHSIZE_32MB=y
CONFIG_SPIRAM_MODE_OCT=y
CONFIG_CODEC_ES8311_SUPPORT=y
CONFIG_CODEC_ES7210_SUPPORT=y
CONFIG_LV_FONT_SOURCE_HAN_SANS_SC_14_CJK=y
CONFIG_LV_FONT_MONTSERRAT_10=y
CONFIG_LV_FONT_MONTSERRAT_14=y
CONFIG_ESP_CONSOLE_USB_SERIAL_JTAG=y
```

## firmware/assistant_espidf/boards/waveshare-esp32-s3-touch-amoled-1.43c/sdkconfig.defaults
```kconfig
CONFIG_SPIRAM_MODE_OCT=y
CONFIG_ESPTOOLPY_FLASHSIZE_8MB=y
CONFIG_CODEC_ES8311_SUPPORT=y
CONFIG_CODEC_ES7210_SUPPORT=y
CONFIG_ESP_CONSOLE_USB_SERIAL_JTAG=y
```

## firmware/assistant_espidf/boards/waveshare-esp32-s3-touch-lcd-4b/sdkconfig.defaults
```kconfig
CONFIG_SPIRAM_MODE_OCT=y
CONFIG_CODEC_ES7210_SUPPORT=y
CONFIG_CODEC_ES8311_SUPPORT=y
CONFIG_ESP_CONSOLE_USB_SERIAL_JTAG=y
CONFIG_SPIRAM_FETCH_INSTRUCTIONS=y
CONFIG_SPIRAM_RODATA=y
```

## firmware/assistant_espidf/boards/waveshare-lcd-1.85b/sdkconfig.defaults
```kconfig
CONFIG_SPIRAM_MODE_OCT=y
CONFIG_CODEC_ES7210_SUPPORT=y
CONFIG_CODEC_ES8311_SUPPORT=y
```

## firmware/assistant_espidf/boards/wk-esp32s3-dev/sdkconfig.defaults
```kconfig
CONFIG_SPIRAM_MODE_OCT=y
CONFIG_LV_FONT_SOURCE_HAN_SANS_SC_14_CJK=y
CONFIG_LV_FONT_MONTSERRAT_10=y
CONFIG_CODEC_DUMMY_SUPPORT=y
```

## firmware/assistant_espidf/sdkconfig.defaults
```kconfig
CONFIG_ESPTOOLPY_FLASHSIZE_16MB=y
CONFIG_SPIRAM=y
CONFIG_SPIRAM_ALLOW_BSS_SEG_EXTERNAL_MEMORY=y
CONFIG_PARTITION_TABLE_CUSTOM=y
CONFIG_PARTITION_TABLE_CUSTOM_FILENAME="partitions.csv"
CONFIG_ESP_MAIN_TASK_STACK_SIZE=8192
CONFIG_COMPILER_OPTIMIZATION_PERF=y
CONFIG_FREERTOS_HZ=1000
CONFIG_LWIP_MAX_SOCKETS=16
CONFIG_ESP_TLS_USING_MBEDTLS=y
CONFIG_MBEDTLS_CERTIFICATE_BUNDLE=y
CONFIG_LV_FONT_SOURCE_HAN_SANS_SC_16_CJK=y
CONFIG_SR_WN_WN9_HILEXIN=n
CONFIG_MODEL_IN_FLASH=y
CONFIG_BSP_DISPLAY_LVGL_BUF_HEIGHT=10
CONFIG_ESP_CONSOLE_USB_SERIAL_JTAG=y
CONFIG_BOOTLOADER_APP_ROLLBACK_ENABLE=y

CONFIG_LV_USE_FONT_COMPRESSED=y

CONFIG_LV_FONT_FMT_TXT_LARGE=y
CONFIG_ESP_WS_CLIENT_SEPARATE_TX_LOCK=y
```
