## firmware/assistant_espidf/boards/dfrobot-df-s3-ai-cam/sdkconfig.defaults
```kconfig
CONFIG_SPIRAM_MODE_OCT=y
CONFIG_CODEC_DUMMY_SUPPORT=y
CONFIG_ESP_PHY_MAX_WIFI_TX_POWER=10
CONFIG_ESP_PHY_MAX_TX_POWER=10
```

## firmware/assistant_espidf/boards/electron-bot/sdkconfig.defaults
```kconfig
CONFIG_SPIRAM_MODE_OCT=y
CONFIG_CODEC_DUMMY_SUPPORT=y
CONFIG_ESP_CONSOLE_USB_SERIAL_JTAG=y
```

## firmware/assistant_espidf/boards/esp32-s3-box-3/sdkconfig.defaults
```kconfig
CONFIG_SPIRAM_MODE_OCT=y
CONFIG_BSP_LCD_DRAW_BUF_HEIGHT=20
CONFIG_BSP_SD_FORMAT_ON_MOUNT_FAIL=n
CONFIG_BSP_SPIFFS_FORMAT_ON_MOUNT_FAIL=n
```

## firmware/assistant_espidf/boards/esp32-s3-box-lite/sdkconfig.defaults
```kconfig
CONFIG_SPIRAM_MODE_OCT=y
CONFIG_BSP_LCD_DRAW_BUF_HEIGHT=20
CONFIG_BSP_SPIFFS_FORMAT_ON_MOUNT_FAIL=n
CONFIG_CODEC_ES8156_SUPPORT=y
CONFIG_CODEC_ES7243E_SUPPORT=y
```

## firmware/assistant_espidf/boards/esp32-s3-box/sdkconfig.defaults
```kconfig
CONFIG_SPIRAM_MODE_OCT=y
CONFIG_BSP_LCD_DRAW_BUF_HEIGHT=20
CONFIG_ESP_LCD_TOUCH_MAX_BUTTONS=1
CONFIG_BSP_SPIFFS_FORMAT_ON_MOUNT_FAIL=n
```

## firmware/assistant_espidf/boards/espressif-esp-sensairshuttle/sdkconfig.defaults
```kconfig
CONFIG_SPIRAM=y
CONFIG_SPIRAM_MODE_QUAD=y
CONFIG_SPIRAM_SPEED_80M=y
CONFIG_CODEC_DATA_ADC_SUPPORT=y
CONFIG_SR_WN_WN9S_NIHAOXIAOZHI=y
```

## firmware/assistant_espidf/boards/espressif-esp-spot-c5/sdkconfig.defaults
```kconfig
CONFIG_ESPTOOLPY_FLASHSIZE_8MB=y
CONFIG_ESPTOOLPY_FLASHSIZE_16MB=n
CONFIG_SPIRAM=y
CONFIG_SPIRAM_MODE_QUAD=y
CONFIG_SPIRAM_SPEED_80M=y
CONFIG_CODEC_ES8311_SUPPORT=y
CONFIG_SR_WN_WN9S_NIHAOXIAOZHI=y
CONFIG_PM_ENABLE=n
CONFIG_FREERTOS_USE_TICKLESS_IDLE=n
```

## firmware/assistant_espidf/boards/espressif-esp32-p4x-function-ev-board/sdkconfig.defaults
```kconfig
CONFIG_BSP_ERROR_CHECK=n
CONFIG_BSP_I2C_NUM=1
CONFIG_BSP_I2S_NUM=0
CONFIG_BSP_LCD_TYPE_1024_600=y
CONFIG_BSP_LCD_COLOR_FORMAT_RGB565=y
CONFIG_BSP_LCD_DPI_BUFFER_NUMS=1
CONFIG_BSP_DISPLAY_LVGL_AVOID_TEAR=n
CONFIG_BSP_SD_FORMAT_ON_MOUNT_FAIL=n
CONFIG_ESP_WIFI_REMOTE_ENABLED=y
CONFIG_ESP_WIFI_REMOTE_LIBRARY_HOSTED=y
CONFIG_SLAVE_IDF_TARGET_ESP32C6=y
CONFIG_ESP_HOSTED_ENABLED=y
CONFIG_ESP_HOSTED_CP_TARGET_ESP32C6=y
CONFIG_ESP_HOSTED_P4_DEV_BOARD_FUNC_BOARD=y
CONFIG_ESP_HOSTED_SDIO_HOST_INTERFACE=y
CONFIG_ESP_HOSTED_SDIO_4_BIT_BUS=y
CONFIG_CODEC_ES8311_SUPPORT=y
CONFIG_SPI_FLASH_SUPPORT_GD_CHIP=y
CONFIG_ESP32P4_SELECTS_REV_LESS_V3=n
CONFIG_ESP32P4_REV_MIN_300=y
```

## firmware/assistant_espidf/boards/espressif-esp32-s31-function-coreboard-1/sdkconfig.defaults
```kconfig
CONFIG_CODEC_ES8311_SUPPORT=y
CONFIG_ESPTOOLPY_FLASHSIZE_16MB=y
CONFIG_MBEDTLS_EXTERNAL_MEM_ALLOC=y
CONFIG_SPIRAM_MALLOC_ALWAYSINTERNAL=1024
CONFIG_SPIRAM_MALLOC_RESERVE_INTERNAL=102400
CONFIG_ESP_WIFI_STATIC_RX_BUFFER_NUM=3
CONFIG_ESP_WIFI_DYNAMIC_RX_BUFFER_NUM=6
CONFIG_ESP_WIFI_RX_BA_WIN=3
CONFIG_LWIP_TCPIP_RECVMBOX_SIZE=16
CONFIG_MBEDTLS_DYNAMIC_FREE_CONFIG_DATA=y
CONFIG_ESP_SYSTEM_EVENT_TASK_STACK_SIZE=4096
```

## firmware/assistant_espidf/boards/espressif-esp32-s31-korvo-1/sdkconfig.defaults
```kconfig
CONFIG_CODEC_ES8389_SUPPORT=y
CONFIG_CODEC_ES8311_SUPPORT=n
CONFIG_ESPTOOLPY_FLASHSIZE_16MB=y
CONFIG_ESP_LCD_TOUCH_MAX_POINTS=2
CONFIG_MBEDTLS_EXTERNAL_MEM_ALLOC=y
CONFIG_SPIRAM_MALLOC_ALWAYSINTERNAL=1024
CONFIG_SPIRAM_MALLOC_RESERVE_INTERNAL=102400
CONFIG_ESP_CONSOLE_UART_DEFAULT=y
CONFIG_ESP_CONSOLE_USB_SERIAL_JTAG=n
CONFIG_ESP_CONSOLE_SECONDARY_USB_SERIAL_JTAG=n
CONFIG_USJ_ENABLE_USB_SERIAL_JTAG=n
```

## firmware/assistant_espidf/boards/freenove-esp32s3-display-2.8-lcd/sdkconfig.defaults
```kconfig
CONFIG_SPIRAM_MODE_OCT=y
CONFIG_CODEC_ES8311_SUPPORT=y
CONFIG_ESP_LCD_TOUCH_MAX_POINTS=2
```

## firmware/assistant_espidf/boards/guition-jc4827w543-ext-amp/sdkconfig.defaults
```kconfig
CONFIG_ESPTOOLPY_FLASHSIZE_4MB=y
CONFIG_SPIRAM_MODE_OCT=y
CONFIG_CODEC_DUMMY_SUPPORT=y
CONFIG_BOOTLOADER_APP_ROLLBACK_ENABLE=n
CONFIG_SR_MN_CN_MULTINET5_RECOGNITION_QUANT8=n
CONFIG_SR_MN_CN_NONE=y
CONFIG_SR_MN_EN_NONE=y
CONFIG_ESP_CONSOLE_USB_SERIAL_JTAG=y
```

## firmware/assistant_espidf/boards/kevin-box-2/sdkconfig.defaults
```kconfig
CONFIG_SPIRAM_MODE_OCT=y
CONFIG_CODEC_ES7210_SUPPORT=y
CONFIG_CODEC_ES8311_SUPPORT=y
CONFIG_LV_FONT_SOURCE_HAN_SANS_SC_14_CJK=y
CONFIG_LV_FONT_MONTSERRAT_10=y
```

## firmware/assistant_espidf/boards/kevin-yuying-313lcd/sdkconfig.defaults
```kconfig
CONFIG_SPIRAM_MODE_OCT=y
CONFIG_CODEC_ES8311_SUPPORT=y
CONFIG_ESP_CONSOLE_USB_SERIAL_JTAG=n
CONFIG_ESP_CONSOLE_UART_DEFAULT=y
CONFIG_ESP_CONSOLE_SECONDARY_NONE=y
```

## firmware/assistant_espidf/boards/lilygo-t-cameraplus-s3/sdkconfig.defaults
```kconfig
CONFIG_SPIRAM_MODE_OCT=n
CONFIG_SPIRAM_MODE_QUAD=y
CONFIG_ESP_CONSOLE_USB_SERIAL_JTAG=y
CONFIG_CODEC_DUMMY_SUPPORT=y
```

## firmware/assistant_espidf/boards/m5stack-atoms3r-cam-m12-echo-base/sdkconfig.defaults
```kconfig
CONFIG_SPIRAM_MODE_OCT=y
CONFIG_ESPTOOLPY_FLASHSIZE_8MB=y
CONFIG_CODEC_ES8311_SUPPORT=y
```

## firmware/assistant_espidf/boards/m5stack-cardputer-adv/sdkconfig.defaults
```kconfig
CONFIG_SPIRAM=n
CONFIG_ESPTOOLPY_FLASHSIZE_8MB=y
CONFIG_CODEC_ES8311_SUPPORT=y
CONFIG_LV_FONT_SOURCE_HAN_SANS_SC_14_CJK=y
CONFIG_LV_FONT_MONTSERRAT_10=y
CONFIG_ESP_CONSOLE_USB_SERIAL_JTAG=y
```

## firmware/assistant_espidf/boards/m5stack-core-s3/sdkconfig.defaults
```kconfig
CONFIG_SPIRAM_MODE_OCT=n
CONFIG_SPIRAM_MODE_QUAD=y
CONFIG_BSP_LCD_DRAW_BUF_HEIGHT=20
CONFIG_BSP_SD_FORMAT_ON_MOUNT_FAIL=n
CONFIG_BSP_SPIFFS_FORMAT_ON_MOUNT_FAIL=n
CONFIG_CODEC_AW88298_SUPPORT=y
```

## firmware/assistant_espidf/boards/m5stack-tab5-p4x/sdkconfig.defaults
```kconfig
CONFIG_ESP_WIFI_REMOTE_ENABLED=y
CONFIG_ESP_WIFI_REMOTE_LIBRARY_HOSTED=y
CONFIG_SLAVE_IDF_TARGET_ESP32C6=y
CONFIG_ESP_HOSTED_ENABLED=y
CONFIG_ESP_HOSTED_CP_TARGET_ESP32C6=y
CONFIG_ESP_HOSTED_P4_DEV_BOARD_NONE=y
CONFIG_ESP_HOSTED_SDIO_HOST_INTERFACE=y
CONFIG_ESP_HOSTED_SDIO_4_BIT_BUS=y
CONFIG_ESP_HOSTED_SDIO_SLOT_1=y
CONFIG_SPI_FLASH_SUPPORT_GD_CHIP=y
CONFIG_CODEC_ES7210_SUPPORT=y
CONFIG_LVGL_PORT_ENABLE_PPA=n
CONFIG_ESP_LCD_TOUCH_MAX_POINTS=5
CONFIG_ESPTOOLPY_FLASHSIZE_16MB=y
CONFIG_SPIRAM_MALLOC_ALWAYSINTERNAL=0
CONFIG_ESP32P4_SELECTS_REV_LESS_V3=n
CONFIG_ESP32P4_REV_MIN_300=y
CONFIG_CODEC_ES8388_SUPPORT=y
CONFIG_CODEC_ES8311_SUPPORT=n
CONFIG_ESP_HOSTED_PRIV_SDIO_PIN_CMD_SLOT_1=13
CONFIG_ESP_HOSTED_PRIV_SDIO_PIN_CLK_SLOT_1=12
CONFIG_ESP_HOSTED_PRIV_SDIO_PIN_D0_SLOT_1=11
CONFIG_ESP_HOSTED_PRIV_SDIO_PIN_D1_4BIT_BUS_SLOT_1=10
CONFIG_ESP_HOSTED_PRIV_SDIO_PIN_D2_4BIT_BUS_SLOT_1=9
CONFIG_ESP_HOSTED_PRIV_SDIO_PIN_D3_4BIT_BUS_SLOT_1=8
CONFIG_ESP_HOSTED_SDIO_GPIO_RESET_SLAVE=15
CONFIG_ESP_HOSTED_SDIO_RESET_ACTIVE_LOW=y
CONFIG_ESP_HOSTED_MEMPOOL_PREFER_SPIRAM=y
```

## firmware/assistant_espidf/boards/maza-ai-esp32-s31/sdkconfig.defaults
```kconfig
CONFIG_CODEC_ES8311_SUPPORT=y
CONFIG_ESPTOOLPY_FLASHSIZE_16MB=y
CONFIG_LV_FONT_SOURCE_HAN_SANS_SC_14_CJK=y
CONFIG_LV_FONT_MONTSERRAT_10=y
CONFIG_MBEDTLS_EXTERNAL_MEM_ALLOC=y
CONFIG_SPIRAM_MALLOC_ALWAYSINTERNAL=1024
CONFIG_SPIRAM_MALLOC_RESERVE_INTERNAL=102400
CONFIG_ESP_CONSOLE_UART_DEFAULT=y
CONFIG_ESP_CONSOLE_USB_SERIAL_JTAG=n
CONFIG_ESP_CONSOLE_SECONDARY_USB_SERIAL_JTAG=n
CONFIG_USJ_ENABLE_USB_SERIAL_JTAG=n
```

## firmware/assistant_espidf/boards/mixgo-nova/sdkconfig.defaults
```kconfig
CONFIG_SPIRAM_MODE_QUAD=y
CONFIG_ESPTOOLPY_FLASHSIZE_8MB=y
CONFIG_CODEC_ES8374_SUPPORT=y
```

## firmware/assistant_espidf/boards/nulllab-ai-vox-v3/sdkconfig.defaults
```kconfig
CONFIG_SPIRAM_MODE_OCT=y
CONFIG_CODEC_ES8311_SUPPORT=y
CONFIG_ESP_CONSOLE_NONE=y
```
